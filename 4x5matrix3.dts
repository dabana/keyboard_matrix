    /dts-v1/;
    /plugin/;
    / {
           compatible = "brcm,bcm2835", "brcm,bcm2708", "brcm,bcm2709";

           fragment@0 {
              target-path = "/";
              __overlay__ {
                 keypad: MATRIX4x5 {
                    compatible = "gpio-matrix-keypad";
                    debounce-delay-ms = <10>;
                    col-scan-delay-us = <10>;
                    /* 
		       try to use GPIO only lines
                       to keep SPI and I2C usable
                    */
                    row-gpios = <&gpio 21 0    // 0
                                 &gpio 20 0      // 1
                                 &gpio 16 0    // 2
                                 &gpio 12 0>;     // 3

                    col-gpios = <&gpio 23 0    // 8
                                 &gpio 18 0    // 9
                                 &gpio 15 0    // 10
                                 &gpio 14 0    // 11
								 &gpio 4 0>;  // 12
                    /*
                      Keycodes from /usr/include/linux/input-event-codes.h
                      converted to hex using printf '%02x\n'
                    */

                    linux,keymap = <
                                    // col0 row0 KEY_LEFT
                                    0x00000010
                                    // col0 row1 KEY_LEFT
                                    0x01000010
                                    // col0 row2 KEY_RIGHT
                                    0x02000010
                                    // col0 row3 KEY_KPENTER
                                    0x03000010
				    // col1 row0 KEY_KP7
                                    0x00010010
                                    // col1 row1 KEY_KP8
                                    0x01010010
                                    // col1 row2 KEY_KP9
                                    0x02010010
                                    // col1 row3 KEY_ESC
                                    0x03010010
                                    // col2 row0 KEY_KP4
                                    0x00020010
                                    // col2 row1 KEY_KP5
                                    0x01020010
                                    // col2 row2 KEY_KP6
                                    0x02020010
                                    // col2 row3 KEY_DOWN
                                    0x03020010
                                    // col3 row0 KEY_KP1
                                    0x00030010
                                    // col3 row1 KEY_KP2
                                    0x01030010
                                    // col3 row2 KEY_KP3
                                    0x02030010
                                    // col3 row3 KEY_UP
                                    0x03030010
                                    // col4 row0 KEY_F1
                                    0x00040010
                                    // col4 row1 KEY_F2
                                    0x01040010
                                    // col4 row2 KEY_KPSLASH there is no KP_#
                                    0x02040010
                                    // col4 row3 KEY_KPASTERISK
                                    0x03040010>;

                 };
              };
           };
      };
