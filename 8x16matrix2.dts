    /dts-v1/;
    /plugin/;
    / {
           compatible = "brcm,bcm2835", "brcm,bcm2708", "brcm,bcm2709";

           fragment@0 {
              target-path = "/";
              __overlay__ {
                 keypad: MATRIX8x16 {
                    compatible = "gpio-matrix-keypad";
                    debounce-delay-ms = <10>;
                    col-scan-delay-us = <10>;
                    /* 
		       try to use GPIO only lines
                       to keep SPI and I2C usable
                    */
                    row-gpios = <&gpio 21 0    // 0
                                 &gpio 20 0      // 1
                                 &gpio 16 0    // 2
                                 &gpio 12 0     // 3
								 &gpio 7 0    // 4
                                 &gpio 8 0    // 5
                                 &gpio 25 0    // 6
                                 &gpio 24 0>;   // 7

                    col-gpios = <&gpio 23 0    // 8
                                 &gpio 18 0    // 9
                                 &gpio 15 0    // 10
                                 &gpio 14 0    // 11
								 &gpio 4 0    // 12
                                 &gpio 17 0    // 13
                                 &gpio 27 0    // 14
                                 &gpio 22 0    // 15
                                 &gpio 10 0    // 16
                                 &gpio 9 0    // 17
								 &gpio 11 0    // 18
                                 &gpio 5 0    // 19
                                 &gpio 19 0    // 20
                                 &gpio 13 0    // 21
                                 &gpio 6 0    // 22
                                 &gpio 26 0>;  // 23
                    /*
                      Keycodes from /usr/include/linux/input-event-codes.h
                      converted to hex using printf '%02x\n'
									// col4 row3 KEY_KPASTERISK
                    */

                    linux,keymap = <
                                    // row0 col0 KEY_Q
									0x00000010
                                    // row0 col0 KEY_Q
									0x01000010                                   
                                    // row0 col0 KEY_Q
									0x02000010
                                    // row0 col0 KEY_Q
									0x03000010     
                                    // row0 col0 KEY_Q
									0x04000010
                                    // row0 col0 KEY_Q
									0x05000010                                   
                                    // row0 col0 KEY_Q
									0x06000010
                                    // row0 col0 KEY_Q
									0x07000010
                                    // row0 col0 KEY_Q
									0x00010010
                                    // row0 col0 KEY_Q
									0x01010010                                   
                                    // row0 col0 KEY_Q
									0x02010010
                                    // row0 col0 KEY_Q
									0x03010010     
                                    // row0 col0 KEY_Q
									0x04010010
                                    // row0 col0 KEY_Q
									0x05010010                                   
                                    // row0 col0 KEY_Q
									0x06010010
                                    // row0 col0 KEY_Q
									0x07010010      
                                    // row0 col0 KEY_Q
									0x00020010
                                    // row0 col0 KEY_Q
									0x01020010                                   
                                    // row0 col0 KEY_Q
									0x02020010
                                    // row0 col0 KEY_Q
									0x03020010     
                                    // row0 col0 KEY_Q
									0x04020010
                                    // row0 col0 KEY_Q
									0x05020010                                   
                                    // row0 col0 KEY_Q
									0x06020010
                                    // row0 col0 KEY_Q
									0x07020010
                                    // row0 col0 KEY_Q
									0x00030010
                                    // row0 col0 KEY_Q
									0x01030010                                   
                                    // row0 col0 KEY_Q
									0x02030010
                                    // row0 col0 KEY_Q
									0x03030010     
                                    // row0 col0 KEY_Q
									0x04030010
                                    // row0 col0 KEY_Q
									0x05030010                                   
                                    // row0 col0 KEY_Q
									0x06030010
                                    // row0 col0 KEY_Q
									0x07030010 
                                    // row0 col0 KEY_Q
									0x00040010
                                    // row0 col0 KEY_Q
									0x01040010                                   
                                    // row0 col0 KEY_Q
									0x02040010
                                    // row0 col0 KEY_Q
									0x03040010     
                                    // row0 col0 KEY_Q
									0x04040010
                                    // row0 col0 KEY_Q
									0x05040010                                   
                                    // row0 col0 KEY_Q
									0x06040010
                                    // row0 col0 KEY_Q
									0x07040010
                                    // row0 col0 KEY_Q
									0x00050010
                                    // row0 col0 KEY_Q
									0x01050010                                   
                                    // row0 col0 KEY_Q
									0x02050010
                                    // row0 col0 KEY_Q
									0x03050010     
                                    // row0 col0 KEY_Q
									0x04050010
                                    // row0 col0 KEY_Q
									0x05050010                                   
                                    // row0 col0 KEY_Q
									0x06050010
                                    // row0 col0 KEY_Q
									0x07050010      
                                    // row0 col0 KEY_Q
									0x00060010
                                    // row0 col0 KEY_Q
									0x01060010                                   
                                    // row0 col0 KEY_Q
									0x02060010
                                    // row0 col0 KEY_Q
									0x03060010     
                                    // row0 col0 KEY_Q
									0x04060010
                                    // row0 col0 KEY_Q
									0x05060010                                   
                                    // row0 col0 KEY_Q
									0x06060010
                                    // row0 col0 KEY_Q
									0x07060010
                                    // row0 col0 KEY_Q
									0x00070010
                                    // row0 col0 KEY_Q
									0x01070010                                   
                                    // row0 col0 KEY_Q
									0x02070010
                                    // row0 col0 KEY_Q
									0x03070010     
                                    // row0 col0 KEY_Q
									0x04070010
                                    // row0 col0 KEY_Q
									0x05070010                                   
                                    // row0 col0 KEY_Q
									0x06070010
                                    // row0 col0 KEY_Q
									0x07070010 
                                    // row0 col0 KEY_Q
									0x00080010
                                    // row0 col0 KEY_Q
									0x01080010                                   
                                    // row0 col0 KEY_Q
									0x02080010
                                    // row0 col0 KEY_Q
									0x03080010     
                                    // row0 col0 KEY_Q
									0x04080010
                                    // row0 col0 KEY_Q
									0x05080010                                   
                                    // row0 col0 KEY_Q
									0x06080010
                                    // row0 col0 KEY_Q
									0x07080010
                                    // row0 col0 KEY_Q
									0x00090010
                                    // row0 col0 KEY_Q
									0x01090010                                   
                                    // row0 col0 KEY_Q
									0x02090010
                                    // row0 col0 KEY_Q
									0x03090010     
                                    // row0 col0 KEY_Q
									0x04090010
                                    // row0 col0 KEY_Q
									0x05090010                                   
                                    // row0 col0 KEY_Q
									0x06090010
                                    // row0 col0 KEY_Q
									0x07090010      
                                    // row0 col0 KEY_Q
									0x000a0010
                                    // row0 col0 KEY_Q
									0x010a0010                                   
                                    // row0 col0 KEY_Q
									0x020a0010
                                    // row0 col0 KEY_Q
									0x030a0010     
                                    // row0 col0 KEY_Q
									0x040a0010
                                    // row0 col0 KEY_Q
									0x050a0010                                   
                                    // row0 col0 KEY_Q
									0x060a0010
                                    // row0 col0 KEY_Q
									0x070a0010
                                    // row0 col0 KEY_Q
									0x000b0010
                                    // row0 col0 KEY_Q
									0x010b0010                                   
                                    // row0 col0 KEY_Q
									0x020b0010
                                    // row0 col0 KEY_Q
									0x030b0010     
                                    // row0 col0 KEY_Q
									0x040b0010
                                    // row0 col0 KEY_Q
									0x050b0010                                   
                                    // row0 col0 KEY_Q
									0x060b0010
                                    // row0 col0 KEY_Q
									0x070b0010 
                                    // row0 col0 KEY_Q
									0x000c0010
                                    // row0 col0 KEY_Q
									0x010c0010                                   
                                    // row0 col0 KEY_Q
									0x020c0010
                                    // row0 col0 KEY_Q
									0x030c0010     
                                    // row0 col0 KEY_Q
									0x040c0010
                                    // row0 col0 KEY_Q
									0x050c0010                                   
                                    // row0 col0 KEY_Q
									0x060c0010
                                    // row0 col0 KEY_Q
									0x070c0010
                                    // row0 col0 KEY_Q
									0x000d0010
                                    // row0 col0 KEY_Q
									0x010d0010                                   
                                    // row0 col0 KEY_Q
									0x020d0010
                                    // row0 col0 KEY_Q
									0x030d0010     
                                    // row0 col0 KEY_Q
									0x040d0010
                                    // row0 col0 KEY_Q
									0x050d0010                                   
                                    // row0 col0 KEY_Q
									0x060d0010
                                    // row0 col0 KEY_Q
									0x070d0010      
                                    // row0 col0 KEY_Q
									0x000e0010
                                    // row0 col0 KEY_Q
									0x010e0010                                   
                                    // row0 col0 KEY_Q
									0x020e0010
                                    // row0 col0 KEY_Q
									0x030e0010     
                                    // row0 col0 KEY_Q
									0x040e0010
                                    // row0 col0 KEY_Q
									0x050e0010                                   
                                    // row0 col0 KEY_Q
									0x060e0010
                                    // row0 col0 KEY_Q
									0x070e0010
                                    // row0 col0 KEY_Q
									0x000f0010
                                    // row0 col0 KEY_Q
									0x010f0010                                   
                                    // row0 col0 KEY_Q
									0x020f0010
                                    // row0 col0 KEY_Q
									0x030f0010     
                                    // row0 col0 KEY_Q
									0x040f0010
                                    // row0 col0 KEY_Q
									0x050f0010                                   
                                    // row0 col0 KEY_Q
									0x060f0010
                                    // row0 col0 KEY_Q
									0x070f0010 
                                   >;
                 };
              };
           };
      };